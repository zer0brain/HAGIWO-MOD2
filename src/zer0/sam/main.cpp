/*
HAGIWO MOD2

SAM Voice Tool v1.0
Real-time speech synthesis with 9 word slots and voice parameter control.
Button cycles through word slots, potentiometers control SAM voice parameters,
trigger input plays current word slot with real-time voice modulation.

-- Pin assignment --
POT1   A0   SAM Pitch control (50-200)
POT2   A1   SAM Speed control (20-180)  
POT3   A2   SAM Mouth/Throat crossfade
TRIG   D7   Trigger input - play current word
BUTTON D6   Word slot selection (10 slots)
OUT    D1   Audio output (PWM)
LED    D5   Activity indicator
EEPROM Not used

Features:
- 10 predefined word slots for musical/rhythmic use
- Real-time SAM voice parameter control via potentiometers
- Crossfade between Mouth and Throat parameters
- LED feedback for slot changes and voice activity
- Robust trigger system with gate detection

CC0 1.0 Universal (CC0 1.0) Public Domain Dedication
You can copy, modify, distribute and perform the work, even for commercial purposes, all without asking permission.

Most of the source code was generated by AI.
Although the code has been tested, it may still exhibit unstable behavior or contain incorrect comments.

[History]
v1.0  - Initial release with arduino-SAM integration
*/

#include <Arduino.h>
#include <sam_arduino.h>

// --- Pin Definitions (HAGIWO MOD2 Style) ---
#define PWM_PIN 1
#define LED_PIN 5
#define TRIG_PIN 7
#define BTN_PIN 6
#define POT1_PIN A0   // Pitch
#define POT2_PIN A1   // Speed
#define POT3_PIN A2   // Crossfade Mouth/Throat

// --- State ---
volatile int wordSlot = 0;
const char* wordSlots[] = {
    "BOOM",
    "CRACK",
    "TSSS",
    "BANG",
    "WORLD",
    "HAGIWO",
    "SAM VOICE",
    "ZERO",
    "MODULAR WORLD",
    "BOOTS AND CATS"
};
const int NUM_WORDS = sizeof(wordSlots) / sizeof(wordSlots[0]);

unsigned long lastBtnTime = 0;
const unsigned long debounce = 80;

// --- Function: Output PCM from SAM (Callback) ---
void samOut(unsigned int len, short* data) {
    for (unsigned int i = 0; i < len; i++) {
        int v = (data[i] + 32768) >> 8; // 16bit signed → 8bit unsigned
        analogWrite(PWM_PIN, v);
        delayMicroseconds(45);
    }
}

SAM sam(samOut);

// --- Setup ---
void setup() {
    pinMode(PWM_PIN, OUTPUT);
    pinMode(LED_PIN, OUTPUT);
    pinMode(TRIG_PIN, INPUT);
    pinMode(BTN_PIN, INPUT_PULLUP);

    analogWriteFreq(22050);
    analogWriteRange(255);
}

// --- Loop ---
void loop() {
    // --- Word Slot Selection per Button ---
    static bool lastBtn = false;
    bool btn = !digitalRead(BTN_PIN);
    if (btn && !lastBtn && (millis() - lastBtnTime > debounce)) {
        wordSlot = (wordSlot + 1) % NUM_WORDS;
        digitalWrite(LED_PIN, HIGH);
        delay(50);
        digitalWrite(LED_PIN, LOW);
        lastBtnTime = millis();
    }
    lastBtn = btn;

    // --- Map potentiometers (sweet spot around middle) ---
    int p1 = analogRead(POT1_PIN); // Pitch
    int p2 = analogRead(POT2_PIN); // Speed
    int p3 = analogRead(POT3_PIN); // Mouth/Throat Crossfade

    uint8_t pitch = map(p1, 0, 1023, 50, 200);
    uint8_t speed = map(p2, 0, 1023, 20, 180);
    float x = p3 / 1023.0f;
    uint8_t mouth  = 128 + (int)(90 * (0.5f - x));
    uint8_t throat = 128 + (int)(90 * (x - 0.5f));

    // --- Trigger: speak current word ---
    if (digitalRead(TRIG_PIN)) {
        sam.setPitch(pitch);
        sam.setSpeed(speed);
        sam.setMouth(mouth);
        sam.setThroat(throat);
        digitalWrite(LED_PIN, HIGH);
        sam.say(wordSlots[wordSlot]);
        digitalWrite(LED_PIN, LOW);
        while (digitalRead(TRIG_PIN));
    }
}
